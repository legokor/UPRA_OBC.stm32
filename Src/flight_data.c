/* USER CODE BEGIN 0 */

/**
*********************************************************************************************************************
* @file    flight_data.c
* @author  Your name
* @version 1.0
* @date    2017. nov. 19.
* @brief   Brief overview of the file
* @bug	   Known bugs
* @test	   Tests made to prove the correct functioning
* @todo	   TODO
**********************************************************************************************************************
* @attention
*
*
* <h2><center>&copy; COPYRIGHT 2017 UPRA TEAM </center></h2>
**********************************************************************************************************************
*/


/**************************************************** INCLUDES ******************************************************/
/********************************************************************************************************************/
#include "flight_data.h"
#include <stdio.h>

/***************************************************** DEFINES ******************************************************/
/********************************************************************************************************************/

/************************************************ TYPE DEFINITIONS **************************************************/
/********************************************************************************************************************/

/************************************************ MODULE VARIABLES **************************************************/
/********************************************************************************************************************/
Telemetry_InitTypeDef TM;

/****************************************** LOCAL FUNCTION DECLARATIONS *********************************************/
/********************************************************************************************************************/


/********************************************* FUNCTION DEFINITIONS *************************************************/
/********************************************************************************************************************/
void InitTelemetry(void)
{

	//"336677,+4545.222,+01133.555,00236,0236,0235"

	  TM.time[0] = '3';
	  TM.time[1] = '3';
	  TM.time[2] = '6';
	  TM.time[3] = '6';
	  TM.time[4] = '7';
	  TM.time[5] = '7';
	  TM.time[6] = '\0';

	  //TM.lati[12] = {'+', '4', '8', '0', '7', '.', '0', '3', '8', '\0'};
	  TM.lati[0] = '+';
	  TM.lati[1] = '9';
	  TM.lati[2] = '5';
	  TM.lati[3] = '0';
	  TM.lati[4] = '0';
	  TM.lati[5] = '.';
	  TM.lati[6] = '0';
	  TM.lati[7] = '0';
	  TM.lati[8] = '0';
	  TM.lati[9] = '\0';

	  //TM.long[13] = {'+', '0', '1', '1', '3', '1', '.', '0', '0', '0', '\0'};
	  TM.longi[0] = '+';
	  TM.longi[1] = '1';
	  TM.longi[2] = '8';
	  TM.longi[3] = '8';
	  TM.longi[4] = '8';
	  TM.longi[5] = '8';
	  TM.longi[6] = '.';
	  TM.longi[7] = '0';
	  TM.longi[8] = '0';
	  TM.longi[9] = '0';
	  TM.longi[10] = '\0';


	TM.altitude = 123;
	TM.msg_count = 0;
}

/* USER CODE END 0 */
